## meta-isar/conf/distro/debian-stretch.conf
```bitbake
# This software is a part of ISAR.
# Copyright (C) 2017 ilbers GmbH

DISTRO_SUITE ?= "stretch"
DISTRO_SEC_SUITE ?= "${DISTRO_SUITE}/updates"
DISTRO_COMPONENTS ?= "main contrib non-free"
DISTRO_APT_SOURCE ?= "http://ftp.debian.org/debian"
DISTRO_SEC_APT_SOURCE ?= "http://security.debian.org/"
DISTRO_CONFIG_SCRIPT ?= "debian-configscript.sh"
```
